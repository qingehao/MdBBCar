## firmware/MdBBCar/bbcar/Kconfig
```kconfig
menu "MDBSP DRIVERS"

    config MDBSP_USING_UART
        bool "MDBSP_USING_UART"
        default n

    config MDBSP_USING_SPI
        bool "MDBSP_USING_SPI"
        default n

    config MDBSP_USING_ADC
        bool "MDBSP_USING_ADC"
        default n

    config MDBSP_USING_PWM
        bool "MDBSP_USING_PWM"
        default n

endmenu
```

## firmware/MdBBCar/board/Kconfig
```kconfig
menu "Hardware Drivers Config"

config SOC_STM32H7B0VBT6
    bool
    select SOC_SERIES_STM32H7
    select RT_USING_COMPONENTS_INIT
    select RT_USING_USER_MAIN
    select BSP_SCB_ENABLE_D_CACHE
    default y

menu "Onboard Peripheral Drivers"

endmenu

menu "On-chip Peripheral Drivers"

    config BSP_SCB_ENABLE_D_CACHE
        bool "BSP_SCB_ENABLE_D_CACHE"
        default y

    config BSP_SCB_ENABLE_I_CACHE
        bool "BSP_SCB_ENABLE_I_CACHE"
        default y

    config BSP_USING_GPIO
        bool "Enable GPIO"
        select RT_USING_PIN
        default y

    menuconfig BSP_USING_UART
        bool "Enable UART"
        default y
        select RT_USING_SERIAL
        if BSP_USING_UART
            config BSP_USING_UART1
                bool "Enable UART1"
                default y

            config BSP_UART1_RX_USING_DMA
                bool "Enable UART1 RX DMA"
                depends on BSP_USING_UART1 && RT_SERIAL_USING_DMA
                default n

            config BSP_USING_UART3
                bool "Enable UART3"
                default y

            config BSP_UART3_RX_USING_DMA
                bool "Enable UART3 RX DMA"
                depends on BSP_USING_UART3 && RT_SERIAL_USING_DMA
                default n

            config BSP_UART3_TX_USING_DMA
                bool "Enable UART3 TX DMA"
                depends on BSP_USING_UART3 && RT_SERIAL_USING_DMA
                default n

        endif

    config BSP_USING_QSPI
        bool "Enable QSPI BUS"
        select RT_USING_QSPI
        select RT_USING_SPI
        default n

    menuconfig BSP_USING_SPI
        bool "Enable SPI BUS"
        default n
        select RT_USING_SPI
        if BSP_USING_SPI
            config BSP_USING_SPI1
                bool "Enable SPI1 BUS"
                default n
            config BSP_USING_SPI2
                bool "Enable SPI2 BUS"
                default n

            config BSP_SPI4_TX_USING_DMA
                bool "Enable SPI4 TX DMA"
                depends on BSP_USING_SPI4
                default n
        endif

    config BSP_USING_DCMI
        bool "Enable DCMI"
        default n

    menuconfig BSP_USING_I2C
        bool "Enable I2C BUS (software simulation)"
        select RT_USING_I2C
        select RT_USING_I2C_BITOPS
        select RT_USING_PIN
        default n
        if BSP_USING_I2C
            menuconfig BSP_USING_I2C1
                bool "Enable I2C1 BUS (software simulation)"
                default n
                if BSP_USING_I2C1
                    comment "Notice: PB8 --> 24; PB9 --> 25"
                    config BSP_I2C1_SCL_PIN
                        int "i2c1 scl pin number"
                        range 1 176
                        default 24
                    config BSP_I2C1_SDA_PIN
                        int "I2C1 sda pin number"
                        range 1 176
                        default 25
                endif

            menuconfig BSP_USING_I2C2
                bool "Enable I2C2 BUS (software simulation)"
                default n
                if BSP_USING_I2C2
                    comment "Notice: PB10 --> 26; PB11 --> 27"
                    config BSP_I2C2_SCL_PIN
                        int "i2c2 scl pin number"
                        range 1 176
                        default 26
                    config BSP_I2C2_SDA_PIN
                        int "I2C2 sda pin number"
                        range 1 176
                        default 27
                endif
        endif

    menuconfig BSP_USING_ONCHIP_RTC
        bool "Enable RTC"
        select RT_USING_RTC
        default n

    config BSP_USING_ON_CHIP_FLASH
        bool "Enable on-chip FLASH"
        default n

    source "$BSP_DIR/libraries/HAL_Drivers/drivers/Kconfig"

endmenu

menu "Board extended module Drivers"

endmenu

endmenu
```

## firmware/MdBBCar/components/Kconfig
```kconfig
menu "App Components"
    config APP_USING_LWRB
        bool "Enable LWRB"
        default n

    config APP_USING_LINK
        bool "Enable LINK PROTOCOL X"
        select APP_USING_LWRB
        default y

    config APP_USING_MOTOR
        bool "Enable MOTOR"
        default n

    config APP_USING_SIMPLEFOC
        bool "Enable SIMPLEFOC"
        default n
endmenu
```
